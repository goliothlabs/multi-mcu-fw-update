## CMakeLists.txt
```
# SPDX-License-Identifier: Apache-2.0

cmake_minimum_required(VERSION 3.20.0)

find_package(Zephyr REQUIRED HINTS $ENV{ZEPHYR_BASE})
project(fw_update)

target_sources(app PRIVATE src/main.c)

zephyr_library_link_libraries(MCUBOOT_BOOTUTIL)
```

## west.yml
```
# Copyright (c) 2022-2023 Golioth, Inc.
# SPDX-License-Identifier: Apache-2.0

manifest:
  version: 0.8

  projects:
    - name: golioth
      path: modules/lib/golioth-firmware-sdk
      revision: v0.11.0
      url: https://github.com/golioth/golioth-firmware-sdk
      west-commands: scripts/west-commands.yml
      import:
        file: west-ncs.yml
        path-prefix: deps
        name-allowlist:
          - nrf
          - zephyr
          - bsdiff
          - cmsis
          - hal_nordic
          - mbedtls
          - mbedtls-nrf
          - mcuboot
          - net-tools
          - nrfxlib
          - qcbor
          - segger
          - tfm-mcuboot
          - tinycrypt
          - trusted-firmware-m
          - zcbor

  self:
    path: app
```

## prj.conf
```kconfig
# Application
CONFIG_GOLIOTH_SAMPLE_COMMON=y
CONFIG_GOLIOTH_SAMPLE_HARDCODED_CREDENTIALS=y
CONFIG_LOG_BACKEND_GOLIOTH=y

# Golioth Firmware SDK with all dependencies
CONFIG_GOLIOTH_FIRMWARE_SDK=y
CONFIG_GOLIOTH_FW_UPDATE=y

CONFIG_FLASH=y
CONFIG_FLASH_MAP=y
CONFIG_STREAM_FLASH=y
CONFIG_IMG_ERASE_PROGRESSIVELY=y

# Firmware version used in FW Update process
CONFIG_MCUBOOT_IMGTOOL_SIGN_VERSION="1.2.3"

CONFIG_GOLIOTH_SAMPLE_PSK_ID="psk-id"
CONFIG_GOLIOTH_SAMPLE_PSK="psk"

CONFIG_GOLIOTH_OTA_MAX_NUM_COMPONENTS=4
CONFIG_GOLIOTH_OTA_MAX_PACKAGE_NAME_LEN=64

# Enable the serial MCUmgr transport.
CONFIG_BASE64=y
CONFIG_CRC=y
CONFIG_MCUMGR_TRANSPORT_UART=y

# Enable MCUmgr and dependencies.
CONFIG_NET_BUF=y
CONFIG_ZCBOR=y
CONFIG_MCUMGR=y

# Required by the `taskstat` command.
CONFIG_THREAD_MONITOR=y

# Enable statistics and statistic names.
CONFIG_STATS=y
CONFIG_STATS_NAMES=y

# Enable most core commands.
CONFIG_IMG_MANAGER=y
CONFIG_MCUMGR_GRP_IMG=y

CONFIG_MCUBOOT_BOOTLOADER_MODE_SINGLE_APP=n
CONFIG_MCUMGR_GRP_IMG_CLIENT=y
#CONFIG_LOG_MAX_LEVEL=3

CONFIG_MCUBOOT_IMG_MANAGER=y
CONFIG_MCUBOOT_BOOTUTIL_LIB=y
CONFIG_SMP_CLIENT=y

CONFIG_DFU_TARGET=y
CONFIG_DFU_TARGET_MCUBOOT=y
```

## boards/nrf9160dk_nrf9160_ns.overlay
```dts
/*
 * Copyright (C) 2024 Golioth, Inc.
 *
 * SPDX-License-Identifier: Apache-2.0
 */

/ {
	chosen {
		zephyr,uart-mcumgr = &uart1;
	};
};

&uart1 {
	status = "okay";
};
```

## src/main.c
```c
/*
 * Copyright (c) 2023 Golioth, Inc.
 *
 * SPDX-License-Identifier: Apache-2.0
 */

#include <zephyr/logging/log.h>
LOG_MODULE_REGISTER(fw_update_sample, LOG_LEVEL_DBG);

#include <golioth/client.h>
#include <golioth/fw_update.h>
#include <samples/common/sample_credentials.h>
#include <string.h>
#include <zephyr/kernel.h>

#include <samples/common/net_connect.h>

#include "pm_config.h"
#include <zephyr/mgmt/mcumgr/mgmt/mgmt.h>
#include <zephyr/mgmt/mcumgr/grp/img_mgmt/img_mgmt.h>
#include <zephyr/mgmt/mcumgr/grp/img_mgmt/img_mgmt_client.h>
#include <zephyr/mgmt/mcumgr/smp/smp.h>
#include <zephyr/mgmt/mcumgr/smp/smp_client.h>
#include <zephyr/mgmt/mcumgr/transport/smp.h>
#include <mgmt/mcumgr/transport/smp_internal.h>

#define AUX_IMAGE_SLOT 1
#define OTA_NAME_MAIN_CPU "main"
#define OTA_NAME_AUXILIARY_CPU "aux-mcu"

// Current firmware version; update in prj.conf or via build argument
static const char *_current_version = CONFIG_MCUBOOT_IMGTOOL_SIGN_VERSION;

static struct golioth_fw_update_config ota_config_main_cpu = {
        .current_version = CONFIG_MCUBOOT_IMGTOOL_SIGN_VERSION,
        .fw_package_name = OTA_NAME_MAIN_CPU,
};

static struct golioth_fw_update_config ota_config_aux_cpu = {
        .current_version = CONFIG_MCUBOOT_IMGTOOL_SIGN_VERSION,
        .fw_package_name = OTA_NAME_AUXILIARY_CPU,
};

static K_SEM_DEFINE(connected, 0, 1);

static void on_client_event(struct golioth_client *client,
                            enum golioth_client_event event,
                            void *arg)
{
    bool is_connected = (event == GOLIOTH_CLIENT_EVENT_CONNECTED);
    if (is_connected)
    {
        k_sem_give(&connected);
    }
    LOG_INF("Golioth client %s", is_connected ? "connected" : "disconnected");
}

void upload_image_to_aux(void)
{

	LOG_INF("Sending the image to AUX MCU");

	static struct img_mgmt_client img_client;
	static struct smp_client_object smp_client;
	struct mcumgr_image_data image_list;
	struct mcumgr_image_upload img_upload;
	int image_list_size = 1;

	int err = 0;
	struct image_version ver;
	uint8_t hash[32];
	uint32_t flags = 0;
	int32_t aux_image_size;

	aux_image_size = get_image_size();

	err = img_mgmt_read_info(AUX_IMAGE_SLOT, &ver, hash, &flags);

	err = smp_client_object_init(&smp_client, SMP_SERIAL_TRANSPORT);
	if(err) {
		LOG_ERR("SMP Client Object init error: %d", err);
	}

	img_mgmt_client_init(&img_client, &smp_client, image_list_size, &image_list);

	err = img_mgmt_client_upload_init(&img_client, aux_image_size, AUX_IMAGE_SLOT, NULL);
	if(err) {
		LOG_ERR("SMP Client Object init error: -%d", err);
	}

	err = img_mgmt_client_upload(&img_client, (uint8_t *)(PM_MCUBOOT_SECONDARY_ADDRESS), aux_image_size, &img_upload);
	if(err) {
		LOG_ERR("IMG MGMT CLIENT UPLOAD ERR: -%d", err);
	}

	LOG_INF("Confirming the AUX image..");
	struct mcumgr_image_state img_state;
	err = img_mgmt_client_state_write(&img_client, hash, true, &img_state);
	if(err) {
		LOG_ERR("CLient State Write error: -%d", err);
	}

	LOG_INF("Reset the AUX MCU ...");
}

int main(void)
{
    LOG_DBG("Start FW Update sample");

    net_connect();

    /* Note: In production, you would provision unique credentials onto each
     * device. For simplicity, we provide a utility to hardcode credentials as
     * kconfig options in the samples.
     */
    const struct golioth_client_config *client_config = golioth_sample_credentials_get();

    struct golioth_client *client = golioth_client_create(client_config);

    golioth_client_register_event_callback(client, on_client_event, NULL);

    golioth_fw_update_init_with_config(client, &ota_config_aux_cpu);

    k_sem_take(&connected, K_FOREVER);

    /* No while(true) loop needed, the Golioth client thread will handle updates */
    golioth_fw_update_register_callback(upload_image_to_aux, NULL);

    return 0;
}
```
